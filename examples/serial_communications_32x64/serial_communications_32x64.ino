//To be updated
#include <Adafruit_GFX.h> 
#include <Fonts/FreeSansBold12pt7b.h>
#include "RGBmatrixPanel.h"  
#include <ArduinoJson.h>
//COMMUNICATIONS ON SERIAL1 - PA9, PA10
//ICONS
 const uint16_t PROGMEM NoEatDrink_bits[] ={
0x0000, 0x0000, 0x0000, 0x0000, 0x0000, 0x0000, 0x0000, 0x0000, 0x0000, 0xf800, 0xf800, 0xf800, 0xf800, 0xf800, 0xf800, 0xf800, 0x0000, 0x0000, 0x0000, 0x0000, 0x0000, 0x0000, 0x0000, 0x0000, 0x0000, 
0x0000, 0x0000, 0x0000, 0x0000, 0x0000, 0x0000, 0x0000, 0xf800, 0xf800, 0xf800, 0xf800, 0xf800, 0xf800, 0xf800, 0xf800, 0xf800, 0xf800, 0xf800, 0x0000, 0x0000, 0x0000, 0x0000, 0x0000, 0x0000, 0x0000, 
0x0000, 0x0000, 0x0000, 0x0000, 0x0000, 0xf800, 0xf800, 0xf800, 0xf800, 0x0000, 0x0000, 0x0000, 0x0000, 0x0000, 0x0000, 0x0000, 0xf800, 0xf800, 0xf800, 0xf800, 0x0000, 0x0000, 0x0000, 0x0000, 0x0000, 
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0x0000, 0x0000, 0x0000, 0x0000, 0x0000, 0x0000, 0x0000, 0x0000, 0x0000, 0xf800, 0xf800, 0xf800, 0xf800, 0xf800, 0xf800, 0xf800, 0x0000, 0x0000, 0x0000, 0x0000, 0x0000, 0x0000, 0x0000, 0x0000, 0x0000
};
 const uint16_t PROGMEM NoSmoking_bits[] ={
0x0000, 0x0000, 0x0000, 0x0000, 0x0000, 0x0000, 0x0000, 0x0000, 0x0000, 0xf800, 0xf800, 0xf800, 0xf800, 0xf800, 0xf800, 0xf800, 0x0000, 0x0000, 0x0000, 0x0000, 0x0000, 0x0000, 0x0000, 0x0000, 0x0000, 
0x0000, 0x0000, 0x0000, 0x0000, 0x0000, 0x0000, 0x0000, 0xf800, 0xf800, 0xf800, 0xf800, 0xf800, 0xf800, 0xf800, 0xf800, 0xf800, 0xf800, 0xf800, 0x0000, 0x0000, 0x0000, 0x0000, 0x0000, 0x0000, 0x0000, 
0x0000, 0x0000, 0x0000, 0x0000, 0x0000, 0xf800, 0xf800, 0xf800, 0xf800, 0x0000, 0x0000, 0x0000, 0x0000, 0x0000, 0x0000, 0x0000, 0xf800, 0xf800, 0xf800, 0xf800, 0x0000, 0x0000, 0x0000, 0x0000, 0x0000, 
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0x0000, 0x0000, 0x0000, 0x0000, 0x0000, 0x0000, 0x0000, 0x0000, 0x0000, 0xf800, 0xf800, 0xf800, 0xf800, 0xf800, 0xf800, 0xf800, 0x0000, 0x0000, 0x0000, 0x0000, 0x0000, 0x0000, 0x0000, 0x0000, 0x0000
};

//ON PORTA
	#define CLK	6
	#define OE 	5
	#define LAT	4
	#define A  	0
	#define B  	1
	#define C  	2
	#define D  	3
 
/****************************************/
  
// Last parameter = 'true' enables double-buffering, for flicker-free,
// buttery smooth animation.  Note that NOTHING WILL SHOW ON THE DISPLAY
// until the first call to swapBuffers().  This is normal.
RGBmatrixPanel matrix(A, B, C, D,CLK, LAT, OE, true, 64);
String text = "RGB led matrix";
String noticetext = "Notice";
byte color1=255;
byte color2=255;
byte color3=255;
int score1=0;
int score2=0;
byte scrolltextenable=1;
byte noticetextenable=0;
byte scoreboardenable=0;
byte countdownenable=0;
byte drawiconenable=0;
byte countdownstart=0;
int iconx=0;
int icony=0;
int iconid=0;
String time1 = "accquring.";
String time2 = "accquring..";
String time3 = "accquring...";

 
int    textS = matrix.width(),
       textM = matrix.width(),
       textL = matrix.width(),
       hue     = 0,
       clockmenu=0;
//total clock value=64*3
//CLOCK Function
void drawIcons(int x, int y, int id){
  switch(id){
  case 0:matrix.drawRGBBitmap(x, y, NoEatDrink_bits, 25, 25); break;
  case 1:matrix.drawRGBBitmap(x, y, NoSmoking_bits, 25, 25); break;
  } 
}
void drawClockBuffer(){
  matrix.setFont();
  matrix.setTextWrap(false); 
  matrix.setTextSize(1);
  matrix.setTextColor(matrix.Color888(200,200,200));
  matrix.setCursor(1, 1);
  matrix.print("26/7/2017");
  matrix.setCursor(1, 9);
  matrix.print("Thursday");
  matrix.setCursor(1, 17);
  matrix.print("6.15PM");
}
void drawTinyClockBuffer(){
   matrix.setFont();
  clockmenu=clockmenu+1;
  matrix.setTextWrap(false); 
  matrix.setTextSize(1);
  matrix.setTextColor(matrix.Color888(200,200,200));
  if(clockmenu<64){
  matrix.setCursor(clockmenu-64, 1); 
  matrix.print(time1);
  }else if(clockmenu<64*2){
  matrix.setCursor(1, 1); 
  matrix.print(time1); 
  }else if(clockmenu<64*3){
  matrix.setCursor(clockmenu-64*2, 1); 
  matrix.print(time1); 
  }else if(clockmenu<64*4){
  matrix.setCursor(clockmenu-64*4, 1); 
  matrix.print(time2);
  }else if(clockmenu<64*5){
  matrix.setCursor(1, 1); 
  matrix.print(time2);  
  }else if(clockmenu<64*6){
  matrix.setCursor(clockmenu-64*5, 1); 
  matrix.print(time2);
  }else if(clockmenu<64*7){
  matrix.setCursor(clockmenu-64*7, 1); 
  matrix.print(time3); 
  }else if(clockmenu<64*8){
  matrix.setCursor(1, 1); 
  matrix.print(time3);  
  }else if(clockmenu<64*9){
  matrix.setCursor(clockmenu-64*8, 1); 
  matrix.print(time3);
  }else {
    clockmenu=0;
  }
}
void drawScoreBoardBuffer(){
  matrix.setFont();
  matrix.setTextWrap(false); 
  matrix.setTextSize(2);
  matrix.setTextColor(matrix.Color888(200,200,0));
  String stringscore1 = String(score1);
  String stringscore2 = String(score2);
  //if(stringscore1>9){}
  matrix.setCursor(1, 9);
  matrix.print(stringscore1);
  if(score2>9){
  matrix.setCursor(64-23, 9);
  }else{
   matrix.setCursor(64-11, 9); 
  }
  matrix.print(stringscore2);
  matrix.setCursor(64-32-5, 9);
  matrix.print("-");
}
void drawNotify(int color1, int color2, int color3){
  matrix.setFont();
  matrix.setTextWrap(false); 
  matrix.setTextSize(1);
  matrix.setTextColor(matrix.Color888(color1,color2,color3));
  matrix.setCursor(textS, 25);
  matrix.print(text);
}
void countdown(float countdown){
  matrix.setFont();
  matrix.setTextWrap(false); 
  matrix.setTextSize(2);
  matrix.setTextColor(matrix.Color888(255,0,0));
  matrix.setCursor(1, 9);
  matrix.print(String(countdown));
 
}
void drawnoticetext(){
  matrix.setFont(&FreeSansBold12pt7b);
  matrix.setTextWrap(false); 
  matrix.setTextSize(1);
  matrix.setTextColor(matrix.Color888(255,0,0));
  matrix.setCursor(textL, 9+17);
  matrix.print(noticetext);
}
 unsigned long countdownvalue=10000;
 unsigned long countdownduration=10000;
 unsigned long countdownlinger=2000;
void setup() {
  delay(1500);pinMode(PB3,OUTPUT);
  pinMode(PB3,INPUT_PULLUP);
  Serial1.begin(115200);
  Serial.begin(250000);
  matrix.begin();
  matrix.setTextWrap(false); // Allow text to run off right edge
  matrix.setTextSize(1);
  matrix.fillScreen(0);
  matrix.swapBuffers(false);
  delay(1000);   
  Serial.println("ok to recieve");   
 
}
String serialget() {
  String reply;
   
  while (Serial1  .available()>0) {
    //char c = Serial1.read();
    //if ((' ' <= c) && (c <= '~')) {
    //  reply += c;
    //}
    reply=Serial1.readStringUntil('\n');
  }
    
  return reply;
}
void parseObjects(String serialdata){
  StaticJsonBuffer<2048> jsonBuffer;
    JsonObject& root = jsonBuffer.parseObject(serialdata);
  // Test if parsing succeeds.
  if (!root.success()) {
    Serial.println("input not valid json");
  }else{
    //scrolltext
     
    color1=root["st"]["rgb"][0];
    color2=root["st"]["rgb"][1];
    color3=root["st"]["rgb"][2];
    const char* mytext = root["st"]["t"];
    scrolltextenable = root["st"]["e"];
    text=String(mytext);
    //scoreboard
    score1=root["sb"]["scr"][0];
    score2=root["sb"]["scr"][1];
    scoreboardenable = root["sb"]["e"];
    //countdown
    countdownduration =root["cd"]["dur"];
    countdownlinger = root["cd"]["lin"];
    countdownenable = root["cd"]["e"];
    if(countdownenable==1){countdownstart=1;}
    //time 
    const char* mytime1 = root["ti"]["v"]["1"];
    const char* mytime2 = root["ti"]["v"]["2"];
    const char* mytime3 = root["ti"]["v"]["3"];
    time1=String(mytime1);
    time2=String(mytime2);
    time3=String(mytime3);
    //noticetext
    const char* mynoticetext = root["nt"]["nt"];
    noticetextenable = root["nt"]["e"];
    noticetext=String(mynoticetext);
    //icon
    iconx = root["ico"]["x"];
    icony = root["ico"]["y"];
    iconid = root["ico"]["id"];
    drawiconenable = root["ico"]["e"];
     
  }
  
}
String serialdata="";
void loop() {
  matrix.fillScreen(0);
  Serial.print("ok");
  if(serialdata!=""){ 
    Serial.println(serialdata);
    Serial.println("im alive");
 
    //format  
     parseObjects(serialdata);
     serialdata="";
  }
   Serial.print("ok1");
 //SCROLL
   int SSizeOf = text.length();
   int LSizeOf = noticetext.length();;
   int SMIN = SSizeOf * -6;
   int LMIN = LSizeOf * -13; //-18 //for default*3
 
   if((--textS) < SMIN){ textS = matrix.width();}
   if((--textL) < LMIN){ textL = matrix.width();}
 
 if(noticetextenable==1){
  drawnoticetext();
 }
 if(scrolltextenable==1){
  drawNotify(color1,color2,color3);
 }
 if(drawiconenable==1){
  drawIcons(iconx, icony, iconid);
 }
 drawTinyClockBuffer();
 if(countdownenable==1){
    if(countdownstart==1){countdownvalue=millis();   countdownstart=0; Serial.println("starting countdown, duration:"+String(countdownduration)+" + "+String(countdownlinger)); if(countdownduration==0){countdownenable=0; Serial.println("invalid duration");}}
  
 unsigned long timepast=millis()-countdownvalue;
 if(timepast<countdownduration+countdownlinger){ 
  if(timepast<countdownduration){//excluding linger duration
 float floattimepast=timepast;
 float floatcountdown=(countdownduration-floattimepast)/1000;
  countdown(floatcountdown);
  }else{
  countdown(0.00);
  }
 
 }else{
    countdownenable=0;
    Serial.println("countdown ended");
 }
 }
 if(scoreboardenable==1){
  drawScoreBoardBuffer();
 } 
  byte fromwhile=0;
 while(digitalRead(PB4)==0){
  digitalWrite(PB3,LOW);
  matrix.timerpause();
  serialdata=serialget();
  if(serialdata.length()>0){Serial.println(serialdata);}
  fromwhile=1;
 }
 if(fromwhile==1){ matrix.timerresume(); fromwhile=0;}
 Serial.print("ok2");
 matrix.swapBuffers(false);
 Serial.println("ok3");
 digitalWrite(PB3,HIGH);
}